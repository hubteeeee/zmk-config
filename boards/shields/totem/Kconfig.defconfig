## boards/shields/totem/Kconfig.defconfig
```kconfig
if SHIELD_TOTEM_LEFT

config ZMK_KEYBOARD_NAME
    default "MCY TOTEM"

config ZMK_SPLIT_ROLE_CENTRAL
    default y

endif # SHIELD_TOTEM_LEFT

if SHIELD_TOTEM_LEFT || SHIELD_TOTEM_RIGHT

config ZMK_SPLIT
    default y

endif # SHIELD_TOTEM_LEFT || SHIELD_TOTEM_RIGHT
```
